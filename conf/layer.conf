## conf/layer.conf
```bitbake
# We have a conf and classes directory, add to BBPATH
BBPATH .= ":${LAYERDIR}"

# We have recipes-* directories, add to BBFILES
BBFILES += "${LAYERDIR}/recipes-*/*/*.bb \
	${LAYERDIR}/recipes-*/*/*.bbappend"

BBFILE_COLLECTIONS += "meta-lora-net"
BBFILE_PATTERN_meta-lora-net = "^${LAYERDIR}/"
BBFILE_PRIORITY_meta-lora-net = "9"
```
